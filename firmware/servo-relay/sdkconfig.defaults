## image/external/Config.in
```kconfig
source "$BR2_EXTERNAL_WAYPOINT_PATH/package/waypoint-agent/Config.in"
source "$BR2_EXTERNAL_WAYPOINT_PATH/package/waypoint-core/Config.in"
source "$BR2_EXTERNAL_WAYPOINT_PATH/package/waypoint-bootcheck/Config.in"
source "$BR2_EXTERNAL_WAYPOINT_PATH/package/waypoint-firstboot/Config.in"
source "$BR2_EXTERNAL_WAYPOINT_PATH/package/waypoint-resize/Config.in"
```

## image/external/package/waypoint-agent/Config.in
```kconfig
config BR2_PACKAGE_WAYPOINT_AGENT
    bool "waypoint-agent"
    depends on BR2_PACKAGE_HOST_GO_TARGET_ARCH_SUPPORTS
    select BR2_PACKAGE_HOST_GO
    help
      The Waypoint Go agent daemon.
      https://github.com/waypointos/waypoint
```

## image/external/package/waypoint-bootcheck/Config.in
```kconfig
config BR2_PACKAGE_WAYPOINT_BOOTCHECK
    bool "waypoint-bootcheck"
    default y
    help
      Tiny helper that clears /data/waypoint/bootcount on successful boot.
      Runs once waypoint-agent has published a healthy heartbeat.
```

## image/external/package/waypoint-core/Config.in
```kconfig
config BR2_PACKAGE_WAYPOINT_CORE
    bool "waypoint-core"
    select BR2_PACKAGE_PROTOBUF
    help
      The Waypoint C++ safety-critical core daemon.
```

## image/external/package/waypoint-firstboot/Config.in
```kconfig
config BR2_PACKAGE_WAYPOINT_FIRSTBOOT
    bool "waypoint-firstboot"
    default y
    help
      First-boot oneshot that copies identity.toml from the FAT32 boot
      partition root into the writable data partition at
      /data/waypoint/identity.toml. Ordered before waypoint-agent.service
      so commissioning works on a fresh flash with no SSH or console
      access required.
```

## image/external/package/waypoint-resize/Config.in
```kconfig
config BR2_PACKAGE_WAYPOINT_RESIZE
    bool "waypoint-resize"
    default y
    help
      First-boot oneshot that grows the trailing "store" partition
      (PARTUUID eeee..., mounted at /data/waypoint/store) to fill the
      whole SD card, then grows its ext4 filesystem online. Idempotent
      via a sentinel on /data; wiping /data re-arms it. Runs before
      waypoint-agent/waypoint-core. Needs sgdisk (gptfdisk), partx
      (util-linux), and resize2fs (e2fsprogs) on the target.
```
